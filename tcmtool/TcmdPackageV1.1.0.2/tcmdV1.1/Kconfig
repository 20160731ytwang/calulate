## tcmtool/TcmdPackageV1.1.0.2/tcmdV1.1/Kconfig
```kconfig
#
# TCM device configuration
#

menu "Nationz TCM devices"

config TCG_TCM
	tristate "TCM Hardware Support"
	depends on EXPERIMENTAL
	---help---
           Support for Nationz TCM .	 

config TCG_TIS
	tristate "TCM Interface Specification 1.2 Interface"
	depends on TCG_TCM && PNPACPI
	---help---
           Support for Nationz TCM.
	  

endmenu
```
